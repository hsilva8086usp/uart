## .pio/build/frdm_kl25z/Kconfig/boards/Kconfig.sysbuild
```kconfig
# Load Sysbuild board Kconfig descriptions.
osource "C:/Users/hsilv/.platformio/packages/framework-zephyr/boards/nxp/frdm_kl25z/Kconfig.sysbuild"
```
